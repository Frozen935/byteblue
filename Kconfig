## Kconfig
```kconfig
# Stack root Kconfig (OpenBlue-decoupled)
# Provides a clean entry point for menuconfig, and stubs for a few external symbols.

mainmenu "OpenBlue Bluetooth Configuration"

config BIG_ENDIAN
	bool "Big-endian"
	default n
	help
	  This option tells the build system that the target system is big-endian.
	  Little-endian architecture is the default and should leave this option
	  unselected.

config LITTLE_ENDIAN
	bool "Little-endian"
	depends on !BIG_ENDIAN
	default y
	help
	  This option tells the build system that the target system is little-endian.

config OPENBLUE_CRYPTO_USE_MBEDTLS
	bool "Use mbed TLS for crypto"
	default y
	help
	  This option enables using mbed TLS for crypto operations.

config OPENBLUE_BT_DRIVER
	bool "Enable Bluetooth driver"
	default y
	help
	  This option enables building the Bluetooth driver.

if OPENBLUE_BT_DRIVER
choice OPENBLUE_BT_DRIVER_TYPE
	prompt "Bluetooth driver type"
	default OPENBLUE_BT_DRIVER_TYPE_NATIVE
	help
	  Select the Bluetooth driver type to use.

config OPENBLUE_BT_DRIVER_TYPE_H4
	bool "H4 driver"
	help
	  Use the H4 Bluetooth driver.

config OPENBLUE_BT_DRIVER_TYPE_NATIVE
	bool "Native driver"
	help
	  Use the native Bluetooth driver.

config OPENBLUE_BT_DRIVER_TYPE_LIBUSB
	bool "LIBUSB driver"
	help
	  Use the LIBUSB Bluetooth driver.

config OPENBLUE_BT_DRIVER_TYPE_USERCHAN
	bool "socket User channel driver"
	help
	  Use the user channel Bluetooth driver.
endchoice
endif

config OPENBLUE_SAMPLES
	bool "Enable samples"
	default n
	help
	  This option enables building samples.

config OPENBLUE_BT_CMD
	bool "Enable Bluetooth command samples"
	default n
	help
	  This option enables building Bluetooth command samples.

config OPENBLUE_TESTS
	bool "Enable tests"
	default n
	help
	  This option enables building tests.

choice OPENBLUE_PLATFORM
	prompt "Target Platform"
	default OPENBLUE_PLATFORM_LINUX
	help
	    Select the target platform.
	
	config OPENBLUE_PLATFORM_LINUX
	    bool "Linux platform"
	    help
	        Run on Linux platform.
	
	config OPENBLUE_PLATFORM_NUTTX
	    bool "NuttX platform"
	    help
	        Run on NuttX platform.

	config OPENBLUE_PLATFORM_WINDOWS
	    bool "Windows platform"
	    help
	        Run on Windows platform.
endchoice

# Source Bluetooth Kconfig tree (relative paths work with Kconfiglib)
source "bluetooth/Kconfig"
```
